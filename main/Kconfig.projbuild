## main/Kconfig.projbuild
```kconfig
menu "PSK receiver hotspot"
    config PSK_AP_SSID
        string "Wi-Fi hotspot name"
        default "ESP32P4-PSK"
    config PSK_AP_PASSWORD
        string "WPA2 password (8 to 63 characters)"
        default "pskmodem32"
    config PSK_AP_CHANNEL
        int "Wi-Fi channel"
        range 1 13
        default 6
endmenu
```

## sdkconfig.defaults
```kconfig
CONFIG_IDF_TARGET="esp32p4"
CONFIG_ESP_DEFAULT_CPU_FREQ_MHZ_400=y
CONFIG_SLAVE_IDF_TARGET_ESP32C6=y
CONFIG_ESP_HOSTED_P4_DEV_BOARD_FUNC_BOARD=y
CONFIG_ESP_HOSTED_SDIO_HOST_INTERFACE=y
CONFIG_ESP32P4_REV_MIN_301=y
CONFIG_ESP_MAIN_TASK_STACK_SIZE=8192
CONFIG_LOG_DEFAULT_LEVEL_INFO=y
CONFIG_FREERTOS_HZ=1000
CONFIG_COMPILER_OPTIMIZATION_PERF=y
CONFIG_ESPTOOLPY_FLASHMODE_QIO=y
CONFIG_ESPTOOLPY_FLASHSIZE_16MB=y
CONFIG_ESPTOOLPY_FLASHSIZE="16MB"
CONFIG_PARTITION_TABLE_CUSTOM=y
CONFIG_PARTITION_TABLE_OFFSET=0x10000
CONFIG_PARTITION_TABLE_CUSTOM_FILENAME="partitions.csv"
CONFIG_PARTITION_TABLE_FILENAME="partitions.csv"
CONFIG_SPIRAM=y
CONFIG_SPIRAM_MODE_HEX=y
CONFIG_SPIRAM_SPEED_200M=y
CONFIG_SPIRAM_ALLOW_BSS_SEG_EXTERNAL_MEMORY=y
CONFIG_IDF_EXPERIMENTAL_FEATURES=y
CONFIG_LV_CONF_SKIP=y
CONFIG_LV_FONT_MONTSERRAT_18=y
CONFIG_LV_FONT_MONTSERRAT_26=y
CONFIG_LV_BUILD_EXAMPLES=n
CONFIG_LV_DEF_REFR_PERIOD=10
CONFIG_LV_USE_CLIB_MALLOC=y
CONFIG_LV_USE_CLIB_SPRINTF=y
CONFIG_LV_USE_CLIB_STRING=y
CONFIG_LV_USE_FLOAT=y
CONFIG_LV_USE_GESTURE_RECOGNITION=y

# K16 hot metrics live in internal SRAM; 128 KiB cache preserves heap headroom.

CONFIG_ESP_HOSTED_MEMPOOL_PREFER_SPIRAM=y

CONFIG_CACHE_L2_CACHE_128KB=y

# Confirmed AP580 wiring: module TX -> GPIO33, module RX <- GPIO32.
```
